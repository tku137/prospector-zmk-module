## Kconfig
```kconfig
choice PROSPECTOR_STATUS_SCREEN_LAYOUT
    prompt "Status screen layout"
    default PROSPECTOR_STATUS_SCREEN_CLASSIC

config PROSPECTOR_STATUS_SCREEN_CLASSIC
    bool "Classic layout"
    help
        Standard Prospector status screen

config PROSPECTOR_STATUS_SCREEN_RADII
    bool "Radii layout"
    help
        Colorful grid layout with rounded widgets

config PROSPECTOR_STATUS_SCREEN_FIELD
    bool "Field layout"
    help
        Minimal layout with flowing typing activity visualization

config PROSPECTOR_STATUS_SCREEN_OPERATOR
    bool "Operator layout"
    help
        Technical and information dense layout

endchoice

config PROSPECTOR_ROTATE_DISPLAY_180
    bool "Rotate the display 180 degrees"
    default n

config PROSPECTOR_SHOW_MODIFIERS
    bool "Display modifier key indicators (Cmd, Opt, Ctrl, Shift)"
    default y

config PROSPECTOR_SHOW_INACTIVE_MODIFIERS
    bool "Show inactive modifier indicators (dim when not pressed)"
    default y
    depends on PROSPECTOR_SHOW_MODIFIERS
    help
      When enabled, inactive modifiers are shown with a dim color.
      When disabled, inactive modifiers are hidden completely.
      Only affects classic and field layouts.

config PROSPECTOR_MODIFIER_ORDER
    string "Modifier display order"
    default "GACS"
    depends on PROSPECTOR_SHOW_MODIFIERS
    help
      Order of modifier indicators. Use exactly 4 characters:
      G=GUI/Cmd, A=Alt/Opt, C=Control, S=Shift.
      Each character must appear exactly once.

choice PROSPECTOR_MODIFIER_OS
    prompt "Modifier key style"
    default PROSPECTOR_MODIFIER_OS_MAC
    depends on PROSPECTOR_SHOW_MODIFIERS

config PROSPECTOR_MODIFIER_OS_GENERIC
    bool "Generic (CTRL, ALT, GUI, SHFT)"

config PROSPECTOR_MODIFIER_OS_WINDOWS
    bool "Windows"

config PROSPECTOR_MODIFIER_OS_MAC
    bool "Mac"

endchoice

config PROSPECTOR_USE_AMBIENT_LIGHT_SENSOR
    bool "Use ambient light sensor for auto brightness"
    default y

config PROSPECTOR_FIXED_BRIGHTNESS
    int "Fixed display brightness"
    default 50
    range 1 100
    depends on !PROSPECTOR_USE_AMBIENT_LIGHT_SENSOR

config PROSPECTOR_LAYER_NAME_UPPERCASE
    bool "Display layer names in uppercase"
    default y
    help
      When enabled, layer names will be converted to uppercase for display.

config PROSPECTOR_BRIGHTNESS_KEYBOARD_CONTROL
    bool "Enable keyboard-driven brightness control"
    default n
    help
      When enabled, specific keycodes can increase, decrease, or toggle the
      display brightness at runtime. The adjustment is applied as a modifier
      on top of the base brightness (ALS or fixed), so ambient light control
      continues to work independently.

config PROSPECTOR_BRIGHTNESS_UP_KEYCODE
    int "Brightness up keycode (HID usage ID)"
    default 115
    depends on PROSPECTOR_BRIGHTNESS_KEYBOARD_CONTROL
    help
      HID usage ID of the key that increases brightness. Default is F24 (115).

config PROSPECTOR_BRIGHTNESS_DOWN_KEYCODE
    int "Brightness down keycode (HID usage ID)"
    default 114
    depends on PROSPECTOR_BRIGHTNESS_KEYBOARD_CONTROL
    help
      HID usage ID of the key that decreases brightness. Default is F23 (114).

config PROSPECTOR_BRIGHTNESS_TOGGLE_KEYCODE
    int "Brightness toggle keycode (HID usage ID)"
    default 113
    depends on PROSPECTOR_BRIGHTNESS_KEYBOARD_CONTROL
    help
      HID usage ID of the key that toggles the display on/off. Default is F22 (113).

config PROSPECTOR_BRIGHTNESS_STEP
    int "Brightness step per keypress (%)"
    default 10
    range 1 50
    depends on PROSPECTOR_BRIGHTNESS_KEYBOARD_CONTROL
    help
      How much to increase or decrease brightness per keypress, in percent.

config PROSPECTOR_ENV_SENSOR
    bool "Enable environmental sensor widget (CCS811 + HTU21D)"
    default n
    depends on PROSPECTOR_STATUS_SCREEN_OPERATOR
    help
      When enabled, replaces the WPM meter in the operator layout with an
      air quality widget driven by a CCS811 eCO2/TVOC sensor and an HTU21D
      temperature/humidity sensor. Both sensors must be wired to the i2c1 bus.
```
